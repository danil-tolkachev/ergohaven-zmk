## boards/shields/k04/Kconfig.defconfig
```kconfig
if SHIELD_K04_QUBE || SHIELD_K04_LEFT

config ZMK_KEYBOARD_NAME
    default "EH K:04"

config ZMK_SPLIT_ROLE_CENTRAL
    default y

endif

if SHIELD_K04_QUBE || SHIELD_K04_LEFT_QUBE || SHIELD_K04_LEFT || SHIELD_K04_RIGHT

config ZMK_SPLIT
    default y

config ZMK_POINTING
    default y

endif
```

## boards/shields/k04/Kconfig.shield
```kconfig
config SHIELD_K04_LEFT_QUBE
    def_bool $(shields_list_contains,k04_left_qube)

config SHIELD_K04_QUBE
    def_bool $(shields_list_contains,k04_qube)

config SHIELD_K04_LEFT
    def_bool $(shields_list_contains,k04_left)

config SHIELD_K04_RIGHT
    def_bool $(shields_list_contains,k04_right)
```

## boards/shields/planeta/Kconfig.defconfig
```kconfig
if SHIELD_PLANETA

config ZMK_KEYBOARD_NAME
    default "EH Planeta v3"

config ZMK_SPLIT
    default n

config ZMK_SPLIT_ROLE_CENTRAL
    default y

config ZMK_POINTING
    default y

endif
```

## boards/shields/trackball/Kconfig.defconfig
```kconfig
if SHIELD_TRACKBALL

config ZMK_KEYBOARD_NAME
    default "Trackball"

config ZMK_SPLIT
    default y

config ZMK_SPLIT_ROLE_CENTRAL
    default y

config ZMK_POINTING
    default y

endif
```
