#include "k04.dtsi"

&trackball_split {
  status = "okay";
};

&trackball_listener {
    status = "okay";
    device = <&trackball_split>;
};

&tps43_listener {
    status = "okay";
    device = <&tps43>;
};
